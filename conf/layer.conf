## conf/layer.conf
```bitbake
# We have a conf and classes directory, add to BBPATH
BBPATH .= ":${LAYERDIR}"

# We have recipes-* directories, add to BBFILES
BBFILES += "${LAYERDIR}/recipes-*/*/*.bb \
            ${LAYERDIR}/recipes-*/*/*.bbappend"

BBFILE_COLLECTIONS += "bgn-essa"
BBFILE_PATTERN_bgn-essa = "^${LAYERDIR}/"

# Should be higher than "uei-arm"
BBFILE_PRIORITY_bgn-essa = "60"

# userspace packages for dm-crypt
IMAGE_INSTALL_append = " libgcc"
IMAGE_INSTALL_append = " udev"
IMAGE_INSTALL_append = " lvm2"
# Install mke2fs for creating ext4 filesystems
IMAGE_INSTALL_append = " e2fsprogs-mke2fs"
IMAGE_INSTALL_append = " coreutils"
IMAGE_INSTALL_append = " keyutils"
IMAGE_INSTALL_append = " util-linux"
IMAGE_INSTALL_append = " cryptodev-module"
# userspace packages for dm-crypt
IMAGE_INSTALL_append = " cryptsetup"
# Adding init script for cryptsetup
IMAGE_INSTALL_append = " sys-setup"
IMAGE_INSTALL_append = " caam-keygen"
# Adding ZModem utility
IMAGE_INSTALL_append = " lrzsz"

IMAGE_OVERHEAD_FACTOR = "${@bb.utils.contains('TEST_BUILD', '1', '1.1', '1.3', d)}"
WKS_FILE = "${@bb.utils.contains('TEST_BUILD', '1', 'test-essa-qspi-boot-dm.wks.in', 'essa-qspi-boot-dm.wks.in', d)}"

LAYERDEPENDS_bgn-essa = "core uei-arm"
LAYERSERIES_COMPAT_bgn-essa = "hardknott"
```
